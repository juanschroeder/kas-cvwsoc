
/ {

  cpus {
    #address-cells = <0x01>;
    #size-cells = <0x00>;

    cpu@0 {
      device_type = "cpu";
      reg = <0x00>;
      status = "okay";
      compatible = "riscv";
      riscv,isa-base = "rv64i";
      riscv,isa-extensions = "i", "m", "a", "f", "d", "c", "sstc", "svade", "svadu", "svinval", "svnapot", "svpbmt", "zba", "zbb", "zbc", "zbs", "zca", "zcb", "zcd", "zfa", "zfh", "zkn", "zkt", "zicbom", "zicboz", "zicntr", "zicond", "zicsr", "zifencei", "zihpm";
      riscv,cboz-block-size = <64>;
      riscv,cbom-block-size = <64>;
      mmu-type = "riscv,sv48";

      cpu_intc: interrupt-controller {
        #address-cells = <0>;
        #interrupt-cells = <0x01>;
        interrupt-controller;
        compatible = "riscv,cpu-intc";
      };
    };
  };

};
