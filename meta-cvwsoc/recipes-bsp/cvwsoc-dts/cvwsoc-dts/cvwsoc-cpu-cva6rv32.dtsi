
/ {

  cpus {
    #address-cells = <0x01>;
    #size-cells = <0x00>;

    cpu@0 {
      device_type = "cpu";
      reg = <0x00>;
      status = "okay";
      compatible = "riscv";
      riscv,isa-base = "rv32i";
      //riscv,isa-extensions = "i", "m", "a", "c", "zba", "zbb", "zbc", "zbs", "zcb", "zicntr", "zicond", "zicsr", "zifencei", "zicbom", "zihpm";
      riscv,isa-extensions =    "i", "m", "a", "c", 
                                "zba", "zbb", "zbc", "zbs", 
                                "zca", "zcb", 
                                "zicntr", "zicond", "zicsr", "zifencei", 
                                "zicbom", "zihpm";
      riscv,cbom-block-size = <0x40>;
      mmu-type = "riscv,sv32";

      cpu_intc: interrupt-controller {
        #address-cells = <0>;
        #interrupt-cells = <0x01>;
        interrupt-controller;
        compatible = "riscv,cpu-intc";
      };
    };
  };

};
